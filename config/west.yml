## config/west.yml
```yaml
manifest:
  remotes:
    - name: zmkfirmware
      url-base: https://github.com/zmkfirmware
    - name: sekigon-gonnoc
      url-base: https://github.com/sekigon-gonnoc
    - name: nat-chan
      url-base: https://github.com/nat-chan
    - name: prospector
      url-base: https://github.com/t-ogura
  projects:
    # Runtime-editable pointer and scroll acceleration.
    - name: zmk-module-runtime-accel
      remote: nat-chan
      revision: main
      import: true
    # Override the imported dependency with the ZMK v0.3 compatible fork.
    - name: zmk-feature-custom-settings
      remote: nat-chan
      revision: v0.3-compat
    # Patched ZMK with custom Studio RPC support.
    - name: zmk
      remote: nat-chan
      revision: 35bb5dafecd5931c432c74e1b630cf12097671e4
      import: app/west.yml
    # Broadcast keyboard status to Prospector Scanner.
    - name: prospector-zmk-module
      remote: prospector
      revision: v2.2.2
      path: modules/prospector-zmk-module
    - name: zmk-component-bmp-boost
      remote: sekigon-gonnoc
      import: west.yml
      revision: v0.2
    - name: zmk-feature-status-led
      remote: sekigon-gonnoc
      revision: main
    - name: zmk-driver-paw3222
      remote: sekigon-gonnoc
      revision: torabo-tsuki
    - name: zmk-driver-iqs7211e
      remote: sekigon-gonnoc
    - name: zmk-feature-cdc-acm-bootloader-trigger
      remote: sekigon-gonnoc
      revision: v0.2
    - name: zmk-feature-non-lipo-battery-management
      remote: sekigon-gonnoc
      revision: main
  self:
    path: config
```
