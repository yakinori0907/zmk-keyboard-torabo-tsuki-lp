#include <input/processors.dtsi>
#include <dt-bindings/zmk/input_transform.h>

&pointing_listener {
    status = "okay";
    device = <&pointing_device>;

    // Normal pointing: runtime acceleration + direction correction +
    // the existing 500 ms auto-mouse layer.
    input-processors = <&pointer_accel>,
                       <&zip_xy_transform (INPUT_TRANSFORM_X_INVERT | INPUT_TRANSFORM_Y_INVERT)>,
                       <&zip_temp_layer 1 500>;

    // Keep the existing scroll layer (layer 5), while adding the runtime
    // scroll curve, horizontal direction correction, and 1/10 scaling.
    scroll_layer {
        layers = <5>;
        input-processors = <&scroll_accel>,
                           <&zip_xy_to_scroll_mapper>,
                           <&zip_scroll_transform (INPUT_TRANSFORM_X_INVERT)>,
                           <&zip_scroll_scaler 1 10>;
    };
};
